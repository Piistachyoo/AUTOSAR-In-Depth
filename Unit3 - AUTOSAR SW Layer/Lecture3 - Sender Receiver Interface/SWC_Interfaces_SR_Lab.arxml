AUTOSAR XML (schema 00046)
package /SR_Interface_Lab
  sender receiver interface Lidar_Distance
    data Lidar_ObjectDistance: type=uint32, init-value=0
    data Lidar_ObjectID: type=uint8
    data Lidar_ObjectAngle: type=uint16
  sensor actuator sw component type LedarSensor_SWC
    provide port PP_Lidar: provided-interface=Lidar_Distance
  application sw component type Lidar_Algorithm_SWC
    require port RP_Lidar: required-interface=Lidar_Distance
