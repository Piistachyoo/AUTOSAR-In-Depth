AUTOSAR XML (schema 00046)
standard types defined: uint8, sint8
package /myDataPack
  physical dimension Distance_In_Meters: length-exp=1
  unit meters: factor-si-to-unit=1, physical-dimension=Distance_In_Meters
  app type MyMetersType: category=VALUE, compu {identical; unit meters}
  application array data type MyMetersArrayType: category=ARRAY
    element element: category=VALUE, type=MyMetersType, array-size-semantics=FIXED-SIZE, max-number-of-elements=4
  application record data type MyPointType: category=STRUCTURE
    application record element X: category=VALUE, type=MyMetersType
    application record element Y: category=VALUE, type=MyMetersType
  base type my_sint8: category=FIXED_LENGTH, base-type-size=8, base-type-encoding=2C, mem-alignment=1, native-declaration=char
  base type my_uint8: category=FIXED_LENGTH, base-type-size=8, base-type-encoding=NONE, mem-alignment=1, native-declaration=unsigned char
  range DC_uint8: phys 0..255, raw 0..255
  range DC_sint8: phys -128..127, raw -128..127
  data type mapping set DATA_Type_Mapping: data-type-map{application-data-type=MyMetersType, implementation-data-type=uint8}
